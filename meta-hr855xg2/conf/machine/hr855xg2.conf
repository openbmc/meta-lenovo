## meta-hr855xg2/conf/machine/hr855xg2.conf
```bitbake
#"Copyright (c) 2019-present Lenovo
#Licensed under BSD-3, see COPYING.BSD file for details."

KMACHINE = "aspeed"
KERNEL_DEVICETREE = "${KMACHINE}-bmc-lenovo-${MACHINE}.dtb"

UBOOT_MACHINE = "ast_g5_phy_config"

require conf/machine/include/ast2500.inc
require conf/machine/include/obmc-bsp-common.inc
require conf/machine/include/lenovo.inc
require conf/distro/include/phosphor-isolation.inc

FLASH_SIZE = "32768"

PREFERRED_PROVIDER_virtual/obmc-host-ipmi-hw = "phosphor-ipmi-bt"
PREFERRED_PROVIDER_virtual/obmc-chassis-mgmt = "packagegroup-lenovo-apps"
PREFERRED_PROVIDER_virtual/obmc-fan-mgmt = "packagegroup-lenovo-apps"
PREFERRED_PROVIDER_virtual/obmc-flash-mgmt = "packagegroup-lenovo-apps"
PREFERRED_PROVIDER_virtual/obmc-system-mgmt = "packagegroup-lenovo-apps"

RDEPENDS_${PN}-extras_remove = " bmcweb obmc-ikvm phosphor-nslcd-cert-config phosphor-nslcd-authority-cert-config"
RDEPENDS_${PN}-user-mgmt_remove = " ${VIRTUAL-RUNTIME_obmc-user-mgmt} nss-pam-ldapd phosphor-ldap"
RDEPENDS_${PN}-fan-control_remove = " ${VIRTUAL-RUNTIME_obmc-fan-control} phosphor-fan-monitor"
RDEPENDS_${PN}-inventory_remove = " ${VIRTUAL-RUNTIME_obmc-fan-presence}"
```
